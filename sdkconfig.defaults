## sdkconfig.defaults
```kconfig
CONFIG_ESPTOOLPY_FLASHSIZE_8MB=y
CONFIG_ESP_DEFAULT_CPU_FREQ_MHZ_240=y
CONFIG_SPIRAM=y
CONFIG_SPIRAM_MODE_OCT=y
CONFIG_SPIRAM_SPEED_80M=y
CONFIG_ESP32S3_DEFAULT_CPU_FREQ_240=y
CONFIG_PEDESTRIAN_DETECT_MODEL_IN_FLASH_RODATA=y
CONFIG_FLASH_PEDESTRIAN_DETECT_PICO_S8_V1=y
```
